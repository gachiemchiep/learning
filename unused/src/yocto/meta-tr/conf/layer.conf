## unused/src/yocto/meta-tr/conf/layer.conf
```bitbake
# We have a conf and classes directory, add to BBPATH
BBPATH =. "${LAYERDIR}:"

# We have recipes-* directories, add to BBFILES
BBFILES += "${LAYERDIR}/recipes-*/*/*.bb \
            ${LAYERDIR}/recipes-*/*/*.bbappend"

BBFILE_COLLECTIONS += "tr"
BBFILE_PATTERN_tr = "^${LAYERDIR}/"
BBFILE_PRIORITY_tr = "10"

# This should only be incremented on significant changes that will
# cause compatibility issues with other layers
LAYERVERSION_tr = "3"

LAYERDEPENDS_tr = "core"

REQUIRED_POKY_BBLAYERS_CONF_VERSION = "2"
```
